## boards/shields/sofle_glidepoint/Kconfig.defconfig
```kconfig
# Copyright (c) 2020 Ryan Cross
# SPDX-License-Identifier: MIT

if SHIELD_SOFLE_GLIDEPOINT_LEFT

config ZMK_KEYBOARD_NAME
    default "Sofle Glidepoint"

config ZMK_SPLIT_ROLE_CENTRAL
    default y

config I2C
    default y

endif

if SHIELD_SOFLE_GLIDEPOINT_LEFT || SHIELD_SOFLE_GLIDEPOINT_RIGHT

config ZMK_SPLIT
    default y

endif
```

## boards/shields/sofle_glidepoint/Kconfig.shield
```kconfig
# Copyright (c) 2020 Ryan Cross
# SPDX-License-Identifier: MIT

config SHIELD_SOFLE_GLIDEPOINT_LEFT
    def_bool $(shields_list_contains,sofle_glidepoint_left)

config SHIELD_SOFLE_GLIDEPOINT_RIGHT
    def_bool $(shields_list_contains,sofle_glidepoint_right)
```

## boards/shields/sofle_gp/Kconfig.defconfig
```kconfig
# Copyright (c) 2020 Ryan Cross
# SPDX-License-Identifier: MIT

if SHIELD_SOFLE_GP_LEFT

config ZMK_KEYBOARD_NAME
    default "Sofle GP"

config ZMK_SPLIT_ROLE_CENTRAL
    default y

config I2C
    default y

endif

if SHIELD_SOFLE_GP_LEFT || SHIELD_SOFLE_GP_RIGHT

config ZMK_SPLIT
    default y

endif
```

## boards/shields/sofle_gp/Kconfig.shield
```kconfig
# Copyright (c) 2020 Ryan Cross
# SPDX-License-Identifier: MIT

config SHIELD_SOFLE_GP_LEFT
    def_bool $(shields_list_contains,sofle_gp_left)

config SHIELD_SOFLE_GP_RIGHT
    def_bool $(shields_list_contains,sofle_gp_right)
```

## boards/shields/sofle_t/Kconfig.defconfig
```kconfig
# Copyright (c) 2020 Ryan Cross
# SPDX-License-Identifier: MIT

if SHIELD_SOFLE_T_LEFT

config ZMK_KEYBOARD_NAME
    default "S"

config ZMK_SPLIT_ROLE_CENTRAL
    default y

config I2C
    default y

endif

if SHIELD_SOFLE_T_LEFT || SHIELD_SOFLE_T_RIGHT

config ZMK_SPLIT
    default y

endif
```

## boards/shields/sofle_t/Kconfig.shield
```kconfig
# Copyright (c) 2020 Ryan Cross
# SPDX-License-Identifier: MIT

config SHIELD_SOFLE_T_LEFT
    def_bool $(shields_list_contains,sofle_t_left)

config SHIELD_SOFLE_T_RIGHT
    def_bool $(shields_list_contains,sofle_t_right)
```
